/*
 * Copyright (C) SanB
 *
 * This program is free software; you can redistribute it and/or modify
 * it under the terms of the GNU General Public License version 2 as
 * published by the Free Software Foundation.
 */

/ {
    SanB_Name_node {
        compatible = "BBB_SanB,BBB_SanB_MyName";
        myName_property = "My name is SanB!";
    };
};
